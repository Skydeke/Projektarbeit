## buildroot_customisations/configs/custom_stm32f769_defconfig
```kconfig
BR2_arm=y
BR2_cortex_m7=y
BR2_PTHREAD_DEBUG=y
BR2_TOOLCHAIN_BUILDROOT_USE_SSP=y
BR2_TOOLCHAIN_BUILDROOT_CXX=y
BR2_DL_DIR="$(TOPDIR)/../dl"
BR2_HOST_DIR="$(TOPDIR)/../host"
BR2_GLOBAL_PATCH_DIR="$(BR2_EXTERNAL_STM32F769_PATH)/stm32f769i-disco/patches"
BR2_TARGET_GENERIC_ROOT_PASSWD="root"
BR2_TARGET_GENERIC_GETTY_PORT="ttySTM0"
BR2_TARGET_GENERIC_GETTY_BAUDRATE_115200=y
BR2_ROOTFS_OVERLAY="$(BR2_EXTERNAL_STM32F769_PATH)/stm32f769i-disco/overlay"
BR2_ROOTFS_POST_BUILD_SCRIPT="$(BR2_EXTERNAL_STM32F769_PATH)/stm32f769i-disco/post-build.sh"
BR2_ROOTFS_POST_IMAGE_SCRIPT="$(TOPDIR)/support/scripts/genimage.sh"
BR2_ROOTFS_POST_SCRIPT_ARGS="-c $(BR2_EXTERNAL_STM32F769_PATH)/stm32f769i-disco/genimage.cfg"
BR2_LINUX_KERNEL=y
BR2_LINUX_KERNEL_CUSTOM_VERSION=y
BR2_LINUX_KERNEL_CUSTOM_VERSION_VALUE="6.10"
BR2_LINUX_KERNEL_USE_CUSTOM_CONFIG=y
BR2_LINUX_KERNEL_CUSTOM_CONFIG_FILE="$(BR2_EXTERNAL_STM32F769_PATH)/stm32f769i-disco/kernel.config"
BR2_LINUX_KERNEL_IMAGE_TARGET_CUSTOM=y
BR2_LINUX_KERNEL_LZ4=y
BR2_LINUX_KERNEL_IMAGE_TARGET_NAME="zImage"
BR2_LINUX_KERNEL_DTS_SUPPORT=y
BR2_LINUX_KERNEL_INTREE_DTS_NAME="st/stm32f769-disco-mb1166-reva09"
BR2_LINUX_KERNEL_INSTALL_TARGET=y
BR2_PACKAGE_BUSYBOX_CONFIG="$(BR2_EXTERNAL_STM32F769_PATH)/stm32f769i-disco/busybox.config"
BR2_PACKAGE_BUSYBOX_SHOW_OTHERS=y
BR2_PACKAGE_LIBPTHREAD_STUBS=y
BR2_TARGET_ROOTFS_EXT2=y
# BR2_TARGET_ROOTFS_TAR is not set
BR2_TARGET_UBOOT=y
BR2_TARGET_UBOOT_BUILD_SYSTEM_KCONFIG=y
BR2_TARGET_UBOOT_CUSTOM_VERSION=y
BR2_TARGET_UBOOT_CUSTOM_VERSION_VALUE="2025.01"
BR2_TARGET_UBOOT_USE_CUSTOM_CONFIG=y
BR2_TARGET_UBOOT_CUSTOM_CONFIG_FILE="$(BR2_EXTERNAL_STM32F769_PATH)/stm32f769i-disco/uboot.config"
BR2_PACKAGE_HOST_GENIMAGE=y
BR2_PACKAGE_HOST_IMAGEMAGICK=y
BR2_PACKAGE_HOST_OPENOCD=y
BR2_PACKAGE_HOST_UBOOT_TOOLS=y
```

## buildroot_customisations/package/hello/Config.in
```kconfig
config BR2_PACKAGE_HELLO
	bool "hello"
	depends on BR2_PACKAGE_SDL
	help
	  Hello world package.

	  http://example.com
```
